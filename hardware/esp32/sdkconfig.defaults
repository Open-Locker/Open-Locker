## hardware/esp32/sdkconfig.defaults
```kconfig
CONFIG_ESPTOOLPY_FLASHSIZE_4MB=y
CONFIG_ESP_CONSOLE_UART_BAUDRATE=115200
CONFIG_FREERTOS_HZ=100
```

## locker-client-esp32/sdkconfig.defaults
```kconfig
CONFIG_ESPTOOLPY_FLASHSIZE_4MB=y
CONFIG_ESP_CONSOLE_UART_BAUDRATE=115200
CONFIG_FREERTOS_HZ=1000
CONFIG_ESP_MAIN_TASK_STACK_SIZE=12288
CONFIG_MBEDTLS_CERTIFICATE_BUNDLE=y
CONFIG_MBEDTLS_CERTIFICATE_BUNDLE_DEFAULT_FULL=y
CONFIG_ESP_TASK_WDT_EN=y
CONFIG_ESP_TASK_WDT_INIT=y
CONFIG_ESP_TASK_WDT_TIMEOUT_S=15
CONFIG_ESP_TASK_WDT_PANIC=y
```

## locker-firmware/components/lc_mqtt_espidf/Kconfig
```kconfig
menu "Locker MQTT transport"

    # Production builds leave this off; sdkconfig.dev turns it on (ADR-0071).
    config LC_ALLOW_PLAINTEXT_MQTT
        bool "Allow plain mqtt:// brokers (development and test only)"
        default n
        help
            Accepts an unencrypted mqtt:// broker URL at commissioning and
            connects to it without TLS. Credentials and commands then cross
            the network in clear text. Never enable this in a release build.
            mqtts:// is verified either way.

endmenu
```

## locker-firmware/components/lc_rs485_lock_board/Kconfig
```kconfig
menu "Locker RS485 lock panel timing"

    config LC_RS485_REPLY_DEADLINE_MS
        int "Reply deadline (ms)"
        range 100 10000
        default 1500
        help
            Longest wait for a complete reply, measured from the write. After
            it an unlock is reported as outcome unknown; it is never retried.

    config LC_RS485_QUIET_INTERVAL_MS
        int "Quiet interval (ms)"
        range 2 1000
        default 25
        help
            Silence between bytes that ends a frame. Must be several byte
            times at the configured baud rate.

    config LC_RS485_SETTLE_PERIOD_MS
        int "Settle period after a failed exchange (ms)"
        range 100 60000
        default 3000
        help
            Silence kept before the next request once a request got no usable
            reply. Bytes received in it are discarded. Must exceed the worst
            reply time of the panel, which is unmeasured until hardware check
            HW-A9.

    config LC_RS485_FAILURES_BEFORE_COOLDOWN
        int "Consecutive failures before a cooldown"
        range 1 255
        default 5

    config LC_RS485_COOLDOWN_MS
        int "Cooldown (ms)"
        range 1000 3600000
        default 60000
        help
            Time during which nothing is written after repeated failures.
            An unlock requested in it is reported as not sent.

endmenu
```

## locker-firmware/components/lc_serial_uart/Kconfig
```kconfig
menu "Locker RS485 serial line"

    # Bench defaults for the ESP32 D1 mini with an XY-485 converter. None of
    # them has been confirmed against the panel documentation yet; see the
    # prerequisites in docs/plans/esp32-rs485-hexagonal-client.md, 1.5.

    config LC_RS485_UART_NUM
        int "UART number"
        range 1 2
        default 2
        help
            UART wired to the RS485 converter. UART 0 carries the USB console.

    config LC_RS485_TX_PIN
        int "TX GPIO"
        range 0 33
        default 17

    config LC_RS485_RX_PIN
        int "RX GPIO"
        range 0 39
        default 16

    config LC_RS485_BAUD_RATE
        int "Baud rate"
        range 1200 115200
        default 9600

    choice LC_RS485_PARITY
        prompt "Parity"
        default LC_RS485_PARITY_NONE

        config LC_RS485_PARITY_NONE
            bool "None"
        config LC_RS485_PARITY_EVEN
            bool "Even"
        config LC_RS485_PARITY_ODD
            bool "Odd"
    endchoice

    config LC_RS485_STOP_BITS
        int "Stop bits"
        range 1 2
        default 1

endmenu
```

## locker-firmware/components/lc_usb_console/Kconfig
```kconfig
menu "Locker USB console"

    config LC_BENCH_CONSOLE
        bool "Bench console: configure, unlock, command and reset-network"
        default y
        help
            The bench console can commission a unit, send an unlock to the
            panel and queue commands over USB. A production build turns this
            off (sdkconfig.production): those four commands then do not exist,
            and a unit is commissioned through the setup network and reset with
            the button (ADR-0074). Development and bench builds keep it on.

endmenu
```

## locker-firmware/main/Kconfig.projbuild
```kconfig
menu "Locker reset button"

    config LC_RESET_BUTTON_GPIO
        int "Reset button GPIO"
        range 0 39
        default 4
        help
            A button from this pin to GND, with the internal pull-up. Held for
            10 s and released, it wipes identity, mapping and network settings
            and keeps the command journal (ADR-0074). The build refuses strapping,
            flash, input-only, console and RS485 pins.

endmenu
```
